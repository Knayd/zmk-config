/*
 * Copyright (c) 2020 The ZMK Contributors
 *
 * SPDX-License-Identifier: MIT
 */

#include <behaviors.dtsi>
#include <dt-bindings/zmk/keys.h>
#include <dt-bindings/zmk/bt.h>
#include <dt-bindings/zmk/rgb.h>
#include <dt-bindings/zmk/pointing.h>
#include <dt-bindings/zmk/oskey.h>
#include <behaviors/oskey.dtsi>
#include <dt-bindings/zmk/mouse.h>

// todos: 
// - eager mods

// Layers
#define _BASE 0
#define _MAC_BASE 1
#define _SYM 2
#define _NAV 3
#define _MAC_NAV 4
#define _WIN 5
#define _NUM 6
#define _CONFIG 7
#define _GAME 8
#define _SWAP_FLAG 9

#define _______ &trans

#define HWU hold-while-undecided;
#define NO_HWU

#define KEYS_LEFT 0 1 2 3 4 5 6 14 15 16 17 18 19 20 28 29 30 31 32 33
#define KEYS_RIGHT 7 8 9 10 11 12 13 21 22 23 24 25 26 27 34 35 36 37 38 39
#define KEYS_THUMB 40 41 42 43 44 45

#define OS_KEY(name, win, mac, lin)                  \
    name: name {                                      \
        compatible = "zmk,behavior-os-key";           \
        #binding-cells = <0>;                         \
        bindings = <win>, <mac>, <lin>;               \
    };


#define ZMK_MACRO_DEF(name, ...)                      \
    name: name {                                      \
        compatible = "zmk,behavior-macro";            \
        #binding-cells = <0>;                         \
        bindings = <__VA_ARGS__>;                     \
    };

#define COMBO(name, keypos, binding)   \
    name {                             \
        timeout-ms = <50>;             \
        key-positions = <keypos>;      \
        bindings = <binding>;          \
    };

#define HOME_ROW_MOD(name, trigger_positions, extra)  \
    name: name {                                      \
        compatible = "zmk,behavior-hold-tap";         \
        #binding-cells = <2>;                         \
        flavor = "balanced";                          \
        require-prior-idle-ms = <150>;                \
        tapping-term-ms = <280>;                      \
        quick-tap-ms = <175>;                         \
        bindings = <&kp>, <&kp>;                      \
        hold-trigger-key-positions = <trigger_positions>; \
        hold-trigger-on-release;                      \
        extra                                         \
    };

/ {
    chosen {
        zmk,physical-layout = &default_layout;
    };
};



/ {
    macros {
        ZMK_MACRO_DEF(bt_win, &bt BT_SEL 0 &os_sel OS_WIN &to _BASE)
        ZMK_MACRO_DEF(bt_mac, &bt BT_SEL 1 &os_sel OS_MAC &to _SWAP_FLAG)
        ZMK_MACRO_DEF(bt_lin, &bt BT_SEL 2 &os_sel OS_LIN &to _BASE)
    };
};

/*
* 0  1  2  3  4  5  6         7  8  9  10 11 12 13
* 14 15 16 17 18 19 20        21 22 23 24 25 26 27
* 28 29 30 31 32 33              34 35 36 37 38 39
*          40 41 42              43 44 45   
*/
/ {
    combos {
        compatible = "zmk,combos";

        COMBO(combo_f1, 1 15, &kp F1)
        COMBO(combo_f2, 2 16, &kp F2)
        COMBO(combo_f3, 3 17, &kp F3)
        COMBO(combo_f4, 4 18, &kp F4)
        COMBO(combo_f5, 5 19, &kp F5)
        COMBO(combo_f6, 8 22, &kp F6)
        COMBO(combo_f7, 9 23, &kp F7)
        COMBO(combo_f8, 10 24, &kp F8)
        COMBO(combo_f9, 11 25, &kp F9)
        COMBO(combo_f10, 12 26, &kp F10)
        COMBO(combo_f11, 41 44, &kp F11)
        COMBO(combo_f12, 42 43, &kp F12)
        COMBO(combo_mb3, 6 20, &mkp MB3)
        COMBO(combo_pp, 7 21, &kp C_PP)
    };
};

/ {
    behaviors {
        // Home row mods
        HOME_ROW_MOD(hml_cs, KEYS_RIGHT KEYS_THUMB, HWU)
        HOME_ROW_MOD(hml_ga, KEYS_RIGHT KEYS_THUMB, NO_HWU)

        HOME_ROW_MOD(hmr_cs, KEYS_LEFT KEYS_THUMB, HWU)
        HOME_ROW_MOD(hmr_ga, KEYS_LEFT KEYS_THUMB, NO_HWU)

        // OS aware keys
        // bindings = Win , Mac , Lin
        
        OS_KEY(os_print, &kp W, &kp M, &kp L)
        OS_KEY(os_toggle, &os_sel OS_MAC, &os_sel OS_LIN, &os_sel OS_WIN)
        OS_KEY(delete_word, &kp LC(BACKSPACE), &kp LA(BACKSPACE), &kp LC(BACKSPACE))
        OS_KEY(next_tab, &kp LC(PG_DN), &kp LG(LS(RBRC)), &kp LC(PG_DN))
        OS_KEY(prev_tab, &kp LC(PG_UP), &kp LG(LS(LBRC)), &kp LC(PG_UP))
        OS_KEY(show_apps, &kp LG(TAB), &kp LC(UP), &kp LG(W))
        OS_KEY(win_left, &kp LG(LEFT), &kp LC(LA(LEFT)), &kp LG(LEFT))
        OS_KEY(win_right, &kp LG(RIGHT), &kp LC(LA(RIGHT)), &kp LG(RIGHT))
        OS_KEY(win_up, &kp LG(UP), &kp LC(LA(UP)), &kp LG(UP))
        OS_KEY(win_down, &kp LG(DOWN), &kp LC(LA(DOWN)), &kp LG(DOWN))
        OS_KEY(win_full, &kp LG(UP), &kp LC(LA(RET)), &kp LG(PG_UP))
        OS_KEY(mon_left, &kp LG(LS(LEFT)), &kp LG(LA(LC(LEFT))), &kp LG(LS(LEFT)))
        OS_KEY(mon_right, &kp LG(LS(RIGHT)), &kp LG(LA(LC(RIGHT))), &kp LG(LS(RIGHT)))
        OS_KEY(show_desk, &kp LG(D), &kp F11, &kp LG(D))
        OS_KEY(scrn_shot, &kp PSCRN, &kp LG(LS(N4)), &kp PSCRN)
        OS_KEY(scrn_rec, &kp LG(LS(R)), &kp LG(LS(N5)), &kp LG(LS(R)))
    };

    conditional_layers {
        compatible = "zmk,conditional-layers";
        swap_base_layer {
            if-layers = <_SWAP_FLAG>;
            then-layer = <_MAC_BASE>;
        };
        swap_nav_layer {
            if-layers = <_SWAP_FLAG _NAV>;
            then-layer = <_MAC_NAV>;
        };
    };

    keymap {
        compatible = "zmk,keymap";

        base_layer {
            display-name = "BASE";
            bindings = <
                &kp ESC     &kp Q           &kp W           &kp E               &kp R           &kp T       &mkp MB2           &kp C_VOL_UP     &kp Y       &kp U               &kp I               &kp O               &kp P               &scrn_shot
                &kp BSPC    &hml_ga LGUI A  &hml_ga LALT S  &hml_cs LSHFT D     &hml_cs LCTRL F &kp G       &mkp MB1           &kp C_VOL_DN     &kp H       &hmr_cs LCTRL J     &hmr_cs LSHFT K     &hmr_ga LALT L      &hmr_ga LGUI SQT    &kp SEMI
                &kp DEL     &kp Z           &kp X           &kp C               &kp V           &kp B                                           &kp N       &kp M               &kp COMMA           &kp DOT             &kp FSLH            &kp CAPS
                                                            &mo _NUM            &lt _NAV TAB    &lt _WIN RET                                    &kp LSHIFT  &lt _SYM SPACE      &mo _CONFIG
            >;
        };

        mac_base_layer {
            display-name = "MAC BASE";
            bindings = <
                _______ _______         _______ _______ _______         _______ _______      _______ _______ _______        _______ _______ _______             _______
                _______ &hml_ga LCTRL A _______ _______ &hml_cs LGUI F  _______ _______      _______ _______ &hmr_cs LGUI J _______ _______ &hmr_ga LCTRL SQT   _______
                _______ _______         _______ _______ _______         _______                      _______ _______        _______ _______ _______             _______
                                                _______ _______         _______                      _______ _______        _______
            >;
        };

        symbol_layer {
            display-name = "SYMBOL";
            bindings = <
                _______ &kp CARET &kp HASH  &kp DQT     &kp DLLR    _______     _______             _______ &kp ASTRK   &kp PRCNT   &kp AMPS &kp PIPE   &kp PLUS    _______
                _______ &kp MINUS &kp LT    &kp GT      &kp EQUAL   &kp GRAVE   _______             _______ &kp EXCL    &kp LPAR    &kp RPAR &kp COLON  &kp UNDER   _______
                _______ &kp BSLH  &kp LBKT  &kp RBKT    &kp AT      _______                                 &kp TILDE   &kp LBRC    &kp RBRC _______    &kp QMARK   _______
                                            _______     &kp SPACE   _______                                 _______     _______     _______
            >;
        };

        nav_layer {
            display-name = "NAVIGATON";
            bindings = <
                _______         &ok_close   _______     &prev_tab   &next_tab   _______ _______         _______ _______ &kp HOME        &kp UP      &kp END     _______ &scrn_rec
                &delete_word    &kp LGUI    &kp LALT    &kp LSHIFT  &kp LCTRL   _______ _______         _______ _______ &kp LEFT        &kp DOWN    &kp RIGHT   _______ _______
                &ok_redo        &ok_undo    &ok_cut     &ok_copy    &ok_paste                                   _______ &kp LA(LC(L))   _______     _______     _______ _______
                                            _______     _______     _______                                     _______ _______         _______
            >;
        };

        mac_nav_layer {
            display-name = "MAC NAV";
            bindings = <
                _______ _______      _______ _______ _______     _______ _______      _______ _______ _______ _______ _______ _______ _______
                _______ &kp LCTRL    _______ _______ &kp LGUI    _______ _______      _______ _______ _______ _______ _______ _______ _______
                _______ _______      _______ _______ _______     _______                      _______ _______ _______ _______ _______ _______
                                             _______ _______     _______                      _______ _______ _______
            >;
        };

        win_layer {
            display-name = "WINMAN";
            bindings = <
                _______     &show_desk  &show_apps  _______     _______     _______ _______     _______ _______     &mon_left   &win_up     &mon_right  _______ _______
                _______     _______     &mkp MB3    &mkp MB2    &mkp MB1    _______ _______     _______ _______     &win_left   &win_down   &win_right  _______ _______
                &ok_redo    &ok_undo    &ok_cut     &ok_copy    &ok_paste   _______                     _______     _______     _______     _______     _______ _______
                                        _______     _______     _______                                 &win_full   _______ _______
            >;
        };

        num_layer {
            display-name = "NUMBERS";
            bindings = <
                _______ _______ _______ _______ _______ _______ _______      _______ &kp ASTRK  &kp N7  &kp N8  &kp N9  &kp PLUS  _______
                _______ _______ _______ _______ _______ _______ _______      _______ &kp SLASH  &kp N4  &kp N5  &kp N6  &kp MINUS _______
                _______ _______ _______ _______ _______ _______                      _______    &kp N1  &kp N2  &kp N3  &kp DOT   &kp EQUAL
                                        _______ _______ _______                      &kp N0     _______ _______
            >;
        };

        config_layer {
            display-name = "CONFIG";
            bindings = <
                &bootloader _______ _______ _______ _______ _______ _______      &os_print  _______     _______         _______         _______         _______     &bootloader
                _______     _______ _______ _______ _______ _______ _______      &os_toggle _______     &bt_win         &bt_mac         &bt_lin         _______     _______
                _______     _______ _______ _______ _______ _______                         _______     &to _BASE       &to _SWAP_FLAG  _______         _______     &to _GAME
                                            _______ _______ _______                         _______     _______         _______
            >;
        };

        game_layer {
            display-name = "GAMING";
            bindings = <
                _______ _______     _______ &kp W       _______     _______ _______      _______ _______    &kp UP      _______ _______ _______ _______
                _______ &kp LSHIFT  &kp A   &kp S       &kp D       _______ _______      _______ &kp LEFT   &kp DOWN    &kp RIGHT _______ _______ _______
                _______ &kp LCTRL   _______ _______     _______     _______                      _______    _______     _______ _______ _______ _______
                                            _______     &kp SPACE   _______                      _______    &kp SPACE   _______
            >;
        };

        flag_swap_layer {
            display-name = "FLAG";
            bindings = <
                _______ _______ _______ _______ _______ _______ _______      _______ _______ _______ _______ _______ _______ _______
                _______ _______ _______ _______ _______ _______ _______      _______ _______ _______ _______ _______ _______ _______
                _______ _______ _______ _______ _______ _______                      _______ _______ _______ _______ _______ _______
                                        _______ _______ _______                      _______ _______ _______
            >;
        };
    };
};
